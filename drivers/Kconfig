## drivers/Kconfig
```kconfig
menu "Device Drivers"

source "drivers/base/Kconfig"

source "drivers/connector/Kconfig"

source "drivers/mtd/Kconfig"

source "drivers/of/Kconfig"

source "drivers/parport/Kconfig"

source "drivers/pnp/Kconfig"

source "drivers/block/Kconfig"

# misc before ide - BLK_DEV_SGIIOC4 depends on SGI_IOC4

source "drivers/misc/Kconfig"

source "drivers/ide/Kconfig"

source "drivers/scsi/Kconfig"

source "drivers/ata/Kconfig"

source "drivers/md/Kconfig"

source "drivers/target/Kconfig"

source "drivers/message/fusion/Kconfig"

source "drivers/firewire/Kconfig"

source "drivers/message/i2o/Kconfig"

source "drivers/macintosh/Kconfig"

source "drivers/net/Kconfig"

source "drivers/isdn/Kconfig"

source "drivers/telephony/Kconfig"

# input before char - char/joystick depends on it. As does USB.

source "drivers/input/Kconfig"

source "drivers/char/Kconfig"

source "drivers/i2c/Kconfig"

source "drivers/spi/Kconfig"

source "drivers/pps/Kconfig"

source "drivers/gpio/Kconfig"

source "drivers/w1/Kconfig"

source "drivers/power/Kconfig"

source "drivers/hwmon/Kconfig"

source "drivers/haptic/Kconfig"

source "drivers/thermal/Kconfig"

source "drivers/watchdog/Kconfig"

source "drivers/ssb/Kconfig"

source "drivers/mfd/Kconfig"

source "drivers/regulator/Kconfig"

source "drivers/media/Kconfig"

source "drivers/video/Kconfig"

source "sound/Kconfig"

source "drivers/hid/Kconfig"

source "drivers/usb/Kconfig"

source "drivers/uwb/Kconfig"

source "drivers/mmc/Kconfig"

source "drivers/memstick/Kconfig"

source "drivers/leds/Kconfig"

source "drivers/nfc/Kconfig"

source "drivers/switch/Kconfig"

source "drivers/accessibility/Kconfig"

source "drivers/infiniband/Kconfig"

source "drivers/edac/Kconfig"

source "drivers/rtc/Kconfig"

source "drivers/dma/Kconfig"

source "drivers/dca/Kconfig"

source "drivers/auxdisplay/Kconfig"

source "drivers/uio/Kconfig"

source "drivers/vlynq/Kconfig"

source "drivers/xen/Kconfig"

source "drivers/staging/Kconfig"

source "drivers/platform/Kconfig"

source "drivers/clk/Kconfig"

source "drivers/hwspinlock/Kconfig"

menuconfig BRCM_MODULES
	tristate "Broadcom Kernel Modules"
	default N
	help
	  Broadcom Kernel Modules

if BRCM_MODULES

menuconfig BRCM_MODULES_PRIV
	tristate "Broadcom Proprietary Kernel Modules"
	depends on BRCM_MODULES
	default N
	help
	  Broadcom Proprietary Kernel Modules

if BRCM_MODULES_PRIV

# source Kconfig for proprietary drivers here
# add "depends on BRCM_MODULES && BRCM_MODULES_PRIV" to Kconfig
source "drivers/video/bmem/Kconfig"
source "drivers/video/hantro/Kconfig"
source "drivers/video/ge/Kconfig"

source "drivers/char/brcm/hal_cam/Kconfig"
source "drivers/char/brcm/camacq/Kconfig"

source "drivers/char/sec/dpram/Kconfig"

source "drivers/char/brcm/fuse_ipc/Kconfig"
source "drivers/char/brcm/fuse_net/Kconfig"
source "drivers/char/brcm/fuse_at/Kconfig"
source "drivers/char/brcm/fuse_ril/Kconfig"
source "drivers/char/brcm/fuse_pdp/Kconfig"
source "drivers/char/brcm/fuse_rpc/Kconfig"
source "drivers/char/brcm/fuse_log/Kconfig"
source "drivers/char/brcm/fuse_sysparm/Kconfig"
source "drivers/char/brcm/fuse_vsp/Kconfig"
source "drivers/char/brcm/xscript/Kconfig"
source "drivers/char/brcm/v3d/Kconfig"

source "drivers/sound/brcm/alsa/Kconfig"
source "drivers/sound/brcm/alsa_athena/Kconfig"
# Headset module
source "drivers/sound/brcm/headset/Kconfig"
source "drivers/gps/brcm/Kconfig"

# video telephony
config VIDEO_TELEPHONY_ENABLE
	boolean "Video Telephony support"
	depends on BRCM_MODULES && BRCM_MODULES_PRIV
	default N
	help
	  Video Telephony support

#OEM RIL
config OEM_RIL_ENABLE
	boolean "OEM RIL support"
	depends on BRCM_MODULES && BRCM_MODULES_PRIV
	default N
	help
	  OEM RIL support

# AGPS control plane 
config BRCM_AGPS_CONTROL_PLANE_ENABLE
	boolean "AGPS control plane support"
	depends on BRCM_MODULES && BRCM_MODULES_PRIV
	default N
	help
	  AGPS control plane support

endif # BRCM_MODULES_PRIV

endif # BRCM_MODULES

endmenu
```
